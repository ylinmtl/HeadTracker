## firmware/src/zephyr/boards/arm/xiao_lab/Kconfig.board
```kconfig
# XIAO BLE board configuration

# Copyright (c) 2022 Marcin Niestroj
# SPDX-License-Identifier: Apache-2.0

config BOARD_XIAO_LAB
	bool "XIAO LAB"
	depends on SOC_NRF52840_QIAA

config BOARD_XIAO_LAB_INIT
	bool "Initializes the internal I2C sensors on the board"
	depends on BOARD_XIAO_LAB
```

## firmware/src/zephyr/boards/arm/xiao_lab/Kconfig.defconfig
```kconfig
# XIAO BLE board configuration

# Copyright (c) 2022 Marcin Niestroj
# SPDX-License-Identifier: Apache-2.0

if BOARD_XIAO_LAB

config BOARD
	default "xiao_lab"

config BT_CTLR
	default BT

config BOARD_XIAO_LAB_INIT
	default y

endif # BOARD_XIAO_LAB

if USB_DEVICE_STACK

config UART_CONSOLE
	default CONSOLE

endif # USB_DEVICE_STACK
```
